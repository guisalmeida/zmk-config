## boards/shields/corne_thinkpad/Kconfig.shield
```kconfig
# Copyright (c) 2020 Pete Johanson
# SPDX-License-Identifier: MIT

config SHIELD_CORNE_THINKPAD_LEFT
    def_bool $(shields_list_contains,corne_thinkpad_left)

config SHIELD_CORNE_THINKPAD_RIGHT
    def_bool $(shields_list_contains,corne_thinkpad_right)
```
